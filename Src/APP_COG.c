/**********************************Mecono.CN***********************************/
/*                                                                            */
/*  @File Name : APP_COG.c                                                    */
/*  @Author    : Mecono                                                       */
/*  @version   : V0.01                                                        */
/*  @Date      : 2014-06-17                                                   */
/*  @attention : COG 应用函数                                                 */
/*                                                                            */
/******************************************************************************/
#include "APP_COG.h"
#include "ASCII_8x6.c"

static uint8_t COG_Pixel[8][128];
extern char ASCII_8X6[96][6];
extern char ASCII_42X30[10][180];

/******************************************************************************/
/*  @函数名   : COG_Init()                                                    */
/*  @输入     :                                                               */
/*  @输出     :                                                               */
/*  @修改时间 : 2014-06-02                                                    */
/*  @描述     : COG初始化                                                     */
/******************************************************************************/
void COG_Init()
{
//    COG_BSP_Init();     /* PIN 初始化 */
    COG_SendCMD(0xE2);  /* 软复位 */
    COG_SendCMD(0x2C);  /* 升压步骤1 */
    COG_SendCMD(0x2E);  /* 升压步骤2 */
    COG_SendCMD(0x2F);  /* 升压步骤3 */
    COG_SendCMD(0x23);  /* 粗调对比度，可设置范围 0x20~0x27 */
    COG_SendCMD(0x81);  /* 微调对比度 */
    COG_SendCMD(0x28);  /* 微调对比度的值，可设置范围 0x00~0x3F */
    COG_SendCMD(0xA2);  /* 1/9 偏压比（bias）*/
    COG_SendCMD(0xC8);  /* 行扫描顺序：从上到下 */
    COG_SendCMD(0xA0);  /* 列扫描顺序：从左到右 */
    COG_SendCMD(0x40);  /* 起始行:第一行开始 */
    COG_SendCMD(0xAF);  /* 开始显示 */
    COG_SendCMD(0xA4);  /* 显示 */
    COG_Clear();
}

/******************************************************************************/
/*  @函数名   : void COG_Address(uint16_t x, uint8_t y)                       */
/*  @输入     : uint16_t x 横坐标                                             */
/*              uint8_t  y 竖坐标                                             */
/*  @输出     ：无                                                            */
/*  @修改时间 : 2014-06-08                                                    */
/*  @描述     : 设置坐标                                                      */
/******************************************************************************/
void COG_Address(uint16_t x, uint8_t y)
{
    x -= 1;
    y -= 1;
	
    COG_SendCMD(0xB0 + y);
    COG_SendCMD((((uint8_t)x >> 4) & 0x0F) + 0x10);
    COG_SendCMD((uint8_t)x & 0x0F);
}

/******************************************************************************/
/*  @函数名   : COG_Clear                                                     */
/*  @输入     :                                                               */
/*  @输出     ：无                                                            */
/*  @修改时间 : 2014-06-20                                                    */
/*  @描述     : 清屏                                                          */
/******************************************************************************/
void COG_Clear()
{
    uint8_t y = 0;
    uint16_t i = 0;
    for(y = 1; y < 9; y++) {
        COG_Address(1 , y);
        for(i = 0; i < 128; i++)
        COG_SendDATA(0x00);
    }
}

/******************************************************************************/
/*  @函数名   : COG_SetPixel                                                  */
/*  @输入     : uint16_t x   像素横坐标                                       */
/*              uint8_t  y   像素竖坐标                                       */
/*              uint8_t  set 1 显示 0 不显示                                  */
/*  @输出     ：无                                                            */
/*  @修改时间 : 2014-06-08                                                    */
/*  @描述     : 设置显示像素点                                                */
/******************************************************************************/
void COG_SetPixel(uint16_t x, uint8_t y,uint8_t set)
{
    uint8_t pageY = 0;
    y--;
    pageY = y/8 + 1;
	y %= 8;	
	COG_Pixel[0][7] = 0xff;
    switch(set) {
        case 0:
            COG_Address(x, pageY);
            x--;
            pageY--;
			COG_Pixel[pageY][x] = COG_Pixel[pageY][x] & (~(uint8_t)(1 << y));		  
            COG_SendDATA(COG_Pixel[pageY][x]);
            break;
        case 1:
            COG_Address(x, pageY);
            x--;
            pageY--;
            COG_Pixel[pageY][x] = COG_Pixel[pageY][x] | ((uint8_t)(1 << y));
            COG_SendDATA(COG_Pixel[pageY][x]);
            break;
        default: 
            break;
    }
}


/******************************************************************************/
/*  @函数名   : COG_DPChar8x6                                                 */
/*  @输入     : uint16_t x   像素横坐标                                       */
/*              uint8_t  y   像素竖坐标                                       */
/*              char ascii   显示的字符                                       */
/*  @输出     ：2 X坐标无效                                                   */
/*              1 Y坐标无效                                                   */
/*              0 显示成功                                                    */
/*  @修改时间 : 2014-07-30                                                    */
/*  @描述     : 显示ASCII 8x6 字符                                            */
/******************************************************************************/
uint8_t COG_DPChar8x6(uint16_t x, uint8_t y, char ascii)
{
    uint16_t i;
    uint16_t Xaddress = 0;
    uint8_t  Yaddress = 0;
    if((x + 8) > 128)
        return 2;
    if(y > 4)
        return 1;
    Xaddress = x - 1;
    Yaddress = y - 1;
		ascii = ascii - 0x20;
    COG_Address(Xaddress, Yaddress);
    for(i = 0; i < 6; i++){
        COG_Pixel[Yaddress][Xaddress] = ASCII_8X6[ascii][i];
        COG_SendDATA(COG_Pixel[Yaddress][Xaddress]);
        Xaddress++;
    }
    return 0;
}

/******************************************************************************/
/*  @函数名   : COG_DPChars8x6                                                */
/*  @输入     : uint16_t x      像素横坐标                                    */
/*              uint8_t  y      像素竖坐标                                    */
/*              char *address   显示字符串首地址                              */
/*              uint16_t number 显示字符串长度                                */
/*  @输出     ：1 坐标无效                                                    */
/*              0 显示成功                                                    */
/*  @修改时间 : 2014-07-30                                                    */
/*  @描述     : 显示ASCII 8x6 字符                                            */
/******************************************************************************/
uint8_t COG_DPChars8x6(uint16_t x, uint8_t y)
{
    uint16_t i, j;
    uint16_t Xaddress = 0;
    uint8_t  Yaddress = 0;

    return 0;
}

/******************************************************************************/
/*  @函数名   : COG_DPChar30x42                                               */
/*  @输入     : uint16_t x   像素横坐标                                       */
/*              uint8_t  y   像素竖坐标                                       */
/*              char ascii   显示的字符                                       */
/*  @输出     ：2 X坐标无效                                                   */
/*              1 Y坐标无效                                                   */
/*              0 显示成功                                                    */
/*  @修改时间 : 2014-07-30                                                    */
/*  @描述     : 显示ASCII 30x42 字符                                          */
/******************************************************************************/
uint8_t COG_DPChar30x42(uint16_t x, uint8_t y, char ascii)
{
    uint16_t i, j;
    uint16_t Xaddress = 0;
    uint8_t  Yaddress = 0;
    Xaddress = x ;
    Yaddress = y ;
    j = 0;
    COG_Address(Xaddress, Yaddress);
    for(i = 0; i < 180; i++) {
        if(j == 30) {
            j = 0;
            Yaddress += 1;
            COG_Address(Xaddress, Yaddress);
        }
        COG_SendDATA(ASCII_42X30[ascii][i]);
        j++;  
    }
    return 0;
}

/******************************************************************************/
/*  @函数名   : COG_DPTemp                                                    */
/*  @输入     : uint16_t Temp   温度                                          */
/*  @输出     ：1 温度超过范围                                                */
/*              0 显示成功                                                    */
/*  @修改时间 : 2016-09-22                                                    */
/*  @描述     : 显示温度                                                      */
/******************************************************************************/
uint8_t COG_DPTemp(uint16_t Temp)
{
    if(Temp > 999) 
        return 1;
    COG_DPChar30x42(5, 2, (Temp / 100));
    COG_DPChar30x42(35, 2, ((Temp / 10) % 10));
    COG_DPChar30x42(65, 2, (Temp  % 10));
    return 0;
}


/******************************************************************************/
/*  @函数名   : W25X40_Read                                                   */
/*  @输入     : uint32_t address : 24 bit address                             */
/*              uint16_t len :读取长度                                        */
/*              uint8_t *buffer : 读取缓冲buffer首指针                        */
/*  @输出     ：无                                                            */
/*  @修改时间 : 2014-06-08                                                    */
/*  @描述     : Flash Read                                                    */
/******************************************************************************/


/******************************************************************************/
/*  @函数名   : W25X40_Write                                                  */
/*  @输入     : uint32_t address : 24 bit address                             */
/*              uint16_t len :写入长度                                        */
/*              uint8_t *buffer : 写入缓冲buffer首指针                        */
/*  @输出     ：无                                                            */
/*  @修改时间 : 2014-06-08                                                    */
/*  @描述     : Flash Write                                                   */
/******************************************************************************/


/******************************************************************************/
/*  @函数名   : W25X40_Sector_Erase                                           */
/*  @输入     : uint32_t address : 24 bit address                             */
/*  @输出     ：无                                                            */
/*  @修改时间 : 2014-06-08                                                    */
/*  @描述     : Flash Sector Erase                                            */
/******************************************************************************/


/******************************************************************************/
/*  @函数名   : SPI1_SendByte                                                 */
/*  @输入     :                                                               */
/*  @输出     ：无                                                            */
/*  @修改时间 : 2014-06-02                                                    */
/*  @描述     : SPI1初始化                                                    */
/******************************************************************************/

/**********************************File  END***********************************/
